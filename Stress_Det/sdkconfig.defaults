## Stress_Det/sdkconfig.defaults
```kconfig
CONFIG_BT_ENABLED=y
CONFIG_BT_NIMBLE_ENABLED=y
CONFIG_SPIRAM=y
CONFIG_SPIRAM_TYPE_ESP32S3=y
CONFIG_SPIRAM_MODE_OCTAL=y
CONFIG_SPIRAM_BOOT_INIT=y
CONFIG_SPIRAM_MALLOC_RESERVE_INTERNAL=32768
CONFIG_SPIRAM_MALLOC_ALWAYSINTERNAL=16384
```
